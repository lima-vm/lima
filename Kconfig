## Kconfig
```kconfig
mainmenu "Lima"

config GUESTAGENT_OS_LINUX
	bool "guestagent OS: Linux"
	help
		Build lima-guestagent for "Linux" OS
	default y

config GUESTAGENT_ARCH_X8664
	bool "guestagent Arch: x86_64"
	help
		Build lima-guestagent for "x86_64" Arch
	default y

config GUESTAGENT_ARCH_AARCH64
	bool "guestagent Arch: aarch64"
	help
		Build lima-guestagent for "aarch64" Arch
	default y

config GUESTAGENT_ARCH_ARMV7L
	bool "guestagent Arch: armv7l"
	help
		Build lima-guestagent for "armv7l" Arch
	default y

config GUESTAGENT_ARCH_RISCV64
	bool "guestagent Arch: riscv64"
	help
		Build lima-guestagent for "riscv64" Arch
	default y

config GUESTAGENT_ARCH_S390X
	bool "guestagent Arch: s390x"
	help
		Build lima-guestagent for "s390x" Arch
	default y

config GUESTAGENT_ARCH_PPC64LE
	bool "guestagent Arch: ppc64le"
	help
		Build lima-guestagent for "ppc64le" Arch
	default y

config GUESTAGENT_COMPRESS
	bool "guestagent compress"
	help
		Compress lima-guestagent
	default n
```
